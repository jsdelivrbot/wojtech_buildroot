## configs/wojtech_kristech_defconfig
```kconfig
BR2_arm=y
BR2_TOOLCHAIN_EXTERNAL=y
BR2_TOOLCHAIN_EXTERNAL_CUSTOM=y
BR2_TOOLCHAIN_EXTERNAL_PATH="/home/pawel/x-tools/arm-unknown-linux-gnueabi"
BR2_TOOLCHAIN_EXTERNAL_CUSTOM_PREFIX="arm-unknown-linux-gnueabi"
BR2_TOOLCHAIN_EXTERNAL_HEADERS_3_2=y
BR2_TOOLCHAIN_EXTERNAL_CUSTOM_GLIBC=y
BR2_TOOLCHAIN_EXTERNAL_CXX=y
BR2_TARGET_GENERIC_HOSTNAME="lnxDev"
BR2_TARGET_GENERIC_ISSUE="LinuksSlonka"
BR2_ROOTFS_DEVICE_TABLE="board/wojtech/kristech-sbc-sam9-1/device_table.txt"
BR2_TARGET_GENERIC_ROOT_PASSWD="toor"
BR2_ROOTFS_USERS_TABLES="board/wojtech/kristech-sbc-sam9-1/users_table.txt"
BR2_ROOTFS_OVERLAY="board/wojtech/kristech-sbc-sam9-1/rootfs_overlay"
BR2_ROOTFS_POST_BUILD_SCRIPT="board/wojtech/kristech-sbc-sam9-1/post_build.sh"
BR2_LINUX_KERNEL=y
BR2_LINUX_KERNEL_CUSTOM_VERSION=y
BR2_LINUX_KERNEL_CUSTOM_VERSION_VALUE="3.4.4"
BR2_LINUX_KERNEL_PATCH="board/wojtech/kristech-sbc-sam9-1/linux-3.4.4-kristech.patch"
BR2_LINUX_KERNEL_DEFCONFIG="kt-sbc-sam9-1"
BR2_PACKAGE_ECUAPP=y
BR2_PACKAGE_DROPBEAR=y
BR2_TARGET_ROOTFS_CPIO=y
BR2_TARGET_ROOTFS_CPIO_UIMAGE=y
```

## configs/wojtech_pi2_defconfig
```kconfig
BR2_arm=y
BR2_arm1176jzf_s=y
BR2_KERNEL_HEADERS_VERSION=y
BR2_DEFAULT_KERNEL_VERSION="3.12.28"
BR2_PACKAGE_HOST_LINUX_HEADERS_CUSTOM_3_12=y
BR2_TOOLCHAIN_BUILDROOT_GLIBC=y
BR2_TOOLCHAIN_BUILDROOT_CXX=y
BR2_TARGET_GENERIC_HOSTNAME="lnxDev"
BR2_TARGET_GENERIC_ISSUE="LinuksSlonka"
BR2_TARGET_GENERIC_ROOT_PASSWD="toor"
BR2_TARGET_GENERIC_GETTY_PORT="tty1"
BR2_ROOTFS_USERS_TABLES="board/wojtech/common/users-table.txt"
BR2_ROOTFS_OVERLAY="board/wojtech/common/rootfs-overlay"
BR2_ROOTFS_POST_BUILD_SCRIPT="board/wojtech/common/post-build.sh"
BR2_LINUX_KERNEL=y
BR2_LINUX_KERNEL_CUSTOM_GIT=y
BR2_LINUX_KERNEL_CUSTOM_REPO_URL="git://github.com/raspberrypi/linux.git"
BR2_LINUX_KERNEL_CUSTOM_REPO_VERSION="c256eb9968c8997dce47350d2075e42f1b3991d3"
BR2_LINUX_KERNEL_DEFCONFIG="bcmrpi_quick"
BR2_LINUX_KERNEL_ZIMAGE=y
BR2_PACKAGE_BUSYBOX_CONFIG="board/wojtech/common/busybox-1.22.1.config"
BR2_PACKAGE_FLITE=y
BR2_PACKAGE_RPI_FIRMWARE=y
BR2_PACKAGE_ECUAPP=y
BR2_PACKAGE_DROPBEAR=y
BR2_TARGET_ROOTFS_CPIO=y
BR2_TARGET_ROOTFS_CPIO_UIMAGE=y
```

## configs/wojtech_qemu_arm_defconfig
```kconfig
BR2_arm=y
BR2_TOOLCHAIN_EXTERNAL=y
BR2_TOOLCHAIN_EXTERNAL_CUSTOM=y
BR2_TOOLCHAIN_EXTERNAL_PATH="/home/pawel/x-tools/arm-unknown-linux-gnueabi"
BR2_TOOLCHAIN_EXTERNAL_CUSTOM_PREFIX="arm-unknown-linux-gnueabi"
BR2_TOOLCHAIN_EXTERNAL_HEADERS_3_2=y
BR2_TOOLCHAIN_EXTERNAL_CUSTOM_GLIBC=y
BR2_TOOLCHAIN_EXTERNAL_CXX=y
BR2_TARGET_GENERIC_HOSTNAME="lnxDev"
BR2_TARGET_GENERIC_ISSUE="LinuksSlonka"
BR2_ROOTFS_DEVICE_TABLE="board/wojtech/common/device-table.txt"
BR2_TARGET_GENERIC_ROOT_PASSWD="toor"
BR2_ROOTFS_USERS_TABLES="board/wojtech/common/users-table.txt"
BR2_ROOTFS_OVERLAY="board/wojtech/common/rootfs-overlay board/wojtech/qemu-arm/rootfs-overlay"
BR2_ROOTFS_POST_BUILD_SCRIPT="board/wojtech/common/post-build.sh board/wojtech/qemu-arm/post-build.sh"
BR2_LINUX_KERNEL=y
BR2_LINUX_KERNEL_CUSTOM_VERSION=y
BR2_LINUX_KERNEL_CUSTOM_VERSION_VALUE="3.4.4"
BR2_LINUX_KERNEL_USE_CUSTOM_CONFIG=y
BR2_LINUX_KERNEL_CUSTOM_CONFIG_FILE="board/wojtech/qemu-arm/linux-3.4.4-qemu.config"
BR2_LINUX_KERNEL_ZIMAGE=y
BR2_PACKAGE_BUSYBOX_CONFIG="board/wojtech/common/busybox-1.22.1.config"
BR2_PACKAGE_ECUAPP=y
BR2_PACKAGE_DROPBEAR=y
BR2_TARGET_ROOTFS_CPIO=y
BR2_TARGET_ROOTFS_CPIO_UIMAGE=y
```

## configs/wojtech_rpi2_defconfig
```kconfig
BR2_arm=y
BR2_cortex_a7=y
BR2_ARM_FPU_NEON_VFPV4=y
BR2_PACKAGE_HOST_LINUX_HEADERS_CUSTOM_4_4=y
BR2_TOOLCHAIN_BUILDROOT_WCHAR=y
BR2_TOOLCHAIN_BUILDROOT_CXX=y
BR2_TARGET_GENERIC_HOSTNAME="lnxDev"
BR2_TARGET_GENERIC_ISSUE="Linuks Slonka"
BR2_TARGET_GENERIC_ROOT_PASSWD="toor"
BR2_SYSTEM_DHCP="eth0"
BR2_ROOTFS_OVERLAY="board/wojtech/common/rootfs-overlay board/wojtech/rpi2/rootfs-overlay"
BR2_ROOTFS_POST_BUILD_SCRIPT="board/raspberrypi2/post-build.sh"
BR2_ROOTFS_POST_IMAGE_SCRIPT="board/raspberrypi2/post-image.sh"
BR2_LINUX_KERNEL=y
BR2_LINUX_KERNEL_CUSTOM_GIT=y
BR2_LINUX_KERNEL_CUSTOM_REPO_URL="https://github.com/raspberrypi/linux.git"
BR2_LINUX_KERNEL_CUSTOM_REPO_VERSION="9669a50a3a8e4f33b4fe138277bc4407e1eab9b2"
BR2_LINUX_KERNEL_DEFCONFIG="bcm2709"
BR2_LINUX_KERNEL_DTS_SUPPORT=y
BR2_LINUX_KERNEL_INTREE_DTS_NAME="bcm2709-rpi-2-b"
BR2_PACKAGE_ALSA_UTILS=y
BR2_PACKAGE_ALSA_UTILS_ALSACONF=y
BR2_PACKAGE_ALSA_UTILS_AMIXER=y
BR2_PACKAGE_ALSA_UTILS_APLAY=y
BR2_PACKAGE_ALSA_UTILS_SPEAKER_TEST=y
BR2_PACKAGE_FLITE=y
BR2_PACKAGE_RPI_FIRMWARE=y
# BR2_PACKAGE_RPI_FIRMWARE_INSTALL_DTB_OVERLAYS is not set
BR2_PACKAGE_ECUAPP=y
BR2_TARGET_ROOTFS_EXT2=y
BR2_TARGET_ROOTFS_EXT2_4=y
# BR2_TARGET_ROOTFS_TAR is not set
BR2_PACKAGE_HOST_DOSFSTOOLS=y
BR2_PACKAGE_HOST_GENIMAGE=y
BR2_PACKAGE_HOST_MTOOLS=y
```

## package/ecuApp/Config.in
```kconfig
config BR2_PACKAGE_ECUAPP
       bool "ecuApp"
       depends on BR2_PACKAGE_FLITE
       help
         This is initial version of the Buildroot package for lnxEmbdDevice
               
comment "ecuApp depends on the FLITE "
       depends on !BR2_PACKAGE_FLITE
```
